## drivers/misc/mediatek/typec/tn_keyboard/Kconfig
```kconfig
#
# The tinno keyboard drivers.  
#
config TN_KEYBOARD
	tristate "Tinno Keypad Support"
	help
	  Say Y here if you want to use the keypad.
	  If unuse, say N.
	  To compile this driver as a module, choose M here: the
	  module will be called.
```
